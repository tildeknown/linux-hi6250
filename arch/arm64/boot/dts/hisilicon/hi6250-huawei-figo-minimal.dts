// SPDX-License-Identifier: GPL-2.0-only
/*
 * Minimal device tree for Huawei P Smart
 *
 * Copyright (C) 2025, Tildeguy (tildeguy@mainlining.org)
 */

/dts-v1/;

#include "hi6250-minimal.dtsi"

/ {
	model = "Huawei P Smart";
	compatible = "huawei,figo", "hisilicon,hi6250";
	chassis-type = "handset";
};
